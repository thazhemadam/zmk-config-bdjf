## config/boards/shields/corne36/Kconfig.shield
```kconfig
# Copyright (c) 2020 Pete Johanson
# SPDX-License-Identifier: MIT

config SHIELD_CORNE36_TPOINT0
	def_bool $(shields_list_contains,corne36_tpoint0)
```
